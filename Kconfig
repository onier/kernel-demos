## Kconfig
```kconfig
# SPDX-License-Identifier: GPL-2.0
menu "xuzhenhai test code"                                                                                                                     
source "drivers/xuzhenhai/hello/Kconfig"
source "drivers/xuzhenhai/kasan-oob/Kconfig"
endmenu
```

## hello/Kconfig
```kconfig
# SPDX-License-Identifier: GPL-2.0-only
#                                                                                                                                         
# GPIO infrastructure and drivers
#

config PUP_HELLO_WORLD_MODULE
	tristate "pup hello world module "
	help
		select this to enable pup hello work module
```

## kasan-oob/Kconfig
```kconfig
# SPDX-License-Identifier: GPL-2.0-only
#                                                                                                                                         
# GPIO infrastructure and drivers
#

config XUZHENHAI_KASAN_OOB
	tristate "check kasan out of memory bound "
	help
		select this to enable kasan out of memory bound  module

config XUZHENHAI_KASAN_TEST
	tristate "test kasan memory function "
	help
		select this to test kasan function

config XUZHENHAI_CHAR_DEV_TEST
	tristate "test char dev "
	help
		select to enable test char dev
```
